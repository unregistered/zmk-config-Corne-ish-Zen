## config/west.yml
```yaml
manifest:
  remotes:
    - name: zmkfirmware
      url-base: https://github.com/okke-formsma
  projects:
    - name: zmk
      remote: zmkfirmware
      revision: Board-Corne-ish-Zen-dedicated-work-queue
      import: app/west.yml
  self:
    path: config
```
